## main/Kconfig.projbuild
```kconfig
menu "100 Percent Clock board adjustments"
    config CLOCK_COMPOSITE_TF_TEST
        bool "EXPERIMENT: composite TV preview on GPIO25 during TF audio/BMP"
        default y
        help
            Testing only on ESP32-2432S022C: fully release LCD I2S0 and
            parallel GPIO25 before starting PAL/NTSC DAC video on GPIO25.
            The LCD retains a frozen image while TV output is active.
            Press STOP or BACK (touch still works) to restore LCD.
            Requires an external composite input; keep GND common.
    config CLOCK_COMPOSITE_NTSC
        bool "Experimental composite television uses NTSC (default PAL)"
        default n
        depends on CLOCK_COMPOSITE_TF_TEST
        help
            Set for televisions that cannot accept PAL. NTSC 320x240
            instead of PAL 320x256. Most European televisions support PAL.
    config CLOCK_LCD_ROTATE_CW
        bool "Use S022C clockwise landscape mapping for LCD and touch"
        default y
    config CLOCK_DISPLAY_FLIP_180
        bool "Flip display and touch 180 degrees (button and TF card on top)"
        default y
        help
            Turn the completed landscape user interface upside down relative
            to the old layout. Applies equally to LCD and touch, so buttons
            remain correctly mapped. Disable if your housing is reversed.
    config CLOCK_LCD_MIRROR_Y
        bool "Mirror display vertically (if needed for your S022C revision)"
        default n
    config CLOCK_TOUCH_SWAP_XY
        bool "Swap X/Y capacitive touch coordinates"
        default n
    config CLOCK_TOUCH_MIRROR_X
        bool "Mirror touch X coordinate"
        default n
    config CLOCK_TOUCH_MIRROR_Y
        bool "Mirror touch Y coordinate"
        default n
    config CLOCK_TOUCH_EDGE_GAIN
        int "Touch edge expansion percent (100 = none)"
        range 100 135
        default 112
        help
            Stretch touch coordinates away from the centre to compensate
            for a touchscreen whose detected range ends before the LCD bezel.
            This is a provisional affine correction, not a measured
            five-point calibration. Increase only if touch dots stop short
            of the outer edges.

    config CLOCK_TOUCH_DEBUG
        bool "Log touch coordinates to serial monitor"
        default n
endmenu
```
